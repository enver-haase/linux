## arch/subleq/Kconfig
```kconfig
# SPDX-License-Identifier: GPL-2.0
# Subleq architecture configuration

config SUBLEQ
	def_bool y
	select ARCH_32BIT_OFF_T
	select LOCK_MM_AND_FIND_VMA if MMU
	select GENERIC_ATOMIC64
	select THREAD_INFO_IN_TASK
	select GENERIC_CSUM
	select GENERIC_HWEIGHT
	select GENERIC_IRQ_SHOW
	select GENERIC_CPU_DEVICES
	select LEGACY_TIMER_TICK
	select OF_EARLY_FLATTREE if OF
	select NO_IOPORT_MAP
	select SET_FS
	select TRACE_IRQFLAGS_SUPPORT
	select UACCESS_MEMCPY
	select ARCH_HAS_STRNCPY_FROM_USER
	select ARCH_HAS_STRNLEN_USER
	select HAVE_PREEMPT_LAZY
	select ARCH_SUPPORTS_LTO_CLANG
	help
	  Subleq is a One Instruction Set Computer (OISC) where the only
	  operation is "subtract and branch if less than or equal to zero."
	  This port runs on the Subleq virtual machine.

config MMU
	def_bool n

config NOMMU
	def_bool !MMU

config GENERIC_BUG
	def_bool y
	depends on BUG

config GENERIC_CALIBRATE_DELAY
	def_bool y

config GENERIC_HWEIGHT
	def_bool y

config GENERIC_CSUM
	def_bool y

config NO_IOPORT_MAP
	def_bool y

config STACKTRACE_SUPPORT
	def_bool y

config LOCKDEP_SUPPORT
	def_bool y

config PGTABLE_LEVELS
	int
	default 2

config ARCH_FORCE_MAX_ORDER
	int
	default 13
	help
	  The maximum page allocation order for the buddy allocator.
	  On NOMMU systems, ELF binaries must be loaded into contiguous
	  memory. With 4KB pages (the MMU port's page size), order 13
	  allows allocations up to 32MB (2^13 * 4KB), which comfortably
	  covers the largest NOMMU-loaded binary (libc++.so.1.0, ~12MB).
	  Contiguous-load pressure disappears once CONFIG_MMU=y (demand
	  paging), so this cap is a NOMMU-only concern.

config PHYS_ADDR_T_64BIT
	def_bool n

config ARCH_SUPPORTS_UPROBES
	def_bool n

config LEGACY_PTYS
	def_bool n
config CMDLINE
	string "Default kernel command string"
	default ""
	help
	  On Subleq, command line arguments can be built into the kernel.
	  Enter any boot arguments here.

config CMDLINE_FORCE
	bool "Always use the default kernel command string"
	default y
	help
	  Always use the built-in command line, ignoring any passed by bootloader.

config HZ
	int
	default 100

source "kernel/Kconfig.hz"
```
